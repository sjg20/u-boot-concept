## configs/A10s-OLinuXino-M-lcd7_defconfig
```kconfig
CONFIG_SPL=y
CONFIG_SYS_EXTRA_OPTIONS="AXP152_POWER,SUNXI_EMAC,USB_EHCI"
CONFIG_FDTFILE="sun5i-a10s-olinuxino-micro.dtb"
CONFIG_MMC_SUNXI_SLOT_EXTRA=1
CONFIG_USB1_VBUS_PIN="PB10"
CONFIG_VIDEO_LCD_MODE="x:800,y:480,depth:18,pclk_khz:33000,le:16,ri:209,up:22,lo:22,hs:30,vs:1,sync:0,vmode:0"
CONFIG_VIDEO_LCD_POWER="PB9"
+S:CONFIG_MMC0_CD_PIN="PG1"
+S:CONFIG_MMC1_CD_PIN="PG13"
+S:CONFIG_ARM=y
+S:CONFIG_ARCH_SUNXI=y
+S:CONFIG_MACH_SUN5I=y
+S:CONFIG_TARGET_A10S_OLINUXINO_M=y
```

## configs/A20-OLinuXino_MICRO-lcd7_defconfig
```kconfig
CONFIG_SPL=y
CONFIG_SYS_EXTRA_OPTIONS="AXP209_POWER,SUNXI_GMAC,AHCI,SATAPWR=SUNXI_GPB(8),USB_EHCI"
CONFIG_FDTFILE="sun7i-a20-olinuxino-micro.dtb"
CONFIG_MMC_SUNXI_SLOT_EXTRA=3
CONFIG_VIDEO_LCD_MODE="x:800,y:480,depth:18,pclk_khz:33000,le:16,ri:209,up:22,lo:22,hs:30,vs:1,sync:0,vmode:0"
CONFIG_VIDEO_LCD_POWER="PH8"
+S:CONFIG_MMC0_CD_PIN="PH1"
+S:CONFIG_MMC3_CD_PIN="PH11"
+S:CONFIG_ARM=y
+S:CONFIG_ARCH_SUNXI=y
+S:CONFIG_MACH_SUN7I=y
+S:CONFIG_TARGET_A20_OLINUXINO_M=y
```

## configs/Linksprite_pcDuino3_fdt_defconfig
```kconfig
CONFIG_SPL=y
CONFIG_SYS_EXTRA_OPTIONS="PCDUINO3,AXP209_POWER,SUNXI_GMAC,AHCI,SATAPWR=SUNXI_GPH(2),USB_EHCI,DM"
CONFIG_FDTFILE="sun7i-a20-pcduino3.dtb"
CONFIG_DEFAULT_DEVICE_TREE="sun7i-a20-pcduino3"
CONFIG_OF_CONTROL=y
CONFIG_OF_SEPARATE=y
+S:CONFIG_ARM=y
+S:CONFIG_TARGET_SUN7I=y
```

## configs/am335x_boneblack_vboot_defconfig
```kconfig
CONFIG_SPL=y
CONFIG_SYS_EXTRA_OPTIONS="EMMC_BOOT,ENABLE_VBOOT"
+S:CONFIG_ARM=y
+S:CONFIG_TARGET_AM335X_EVM=y
```

## configs/chromeos_sandbox_defconfig
```kconfig
CONFIG_SANDBOX=y
CONFIG_TARGET_CHROMEOS_SANDBOX=y
CONFIG_OF_CONTROL=y
CONFIG_OF_HOSTFILE=y
CONFIG_DEFAULT_DEVICE_TREE="sandbox"
```

## configs/efi-arm_app64_defconfig
```kconfig
CONFIG_ARM=y
# CONFIG_ARM64_CRC32 is not set
CONFIG_ARCH_EFI_ARM=y
CONFIG_NR_DRAM_BANKS=8
CONFIG_ENV_SIZE=0x1000
CONFIG_DEFAULT_DEVICE_TREE="efi-arm_app"
CONFIG_DEBUG_UART_BASE=0x0
CONFIG_DEBUG_UART_CLOCK=0
CONFIG_DEBUG_UART=y
CONFIG_TARGET_EFI_ARM_APP64=y
CONFIG_EFI_CLIENT=y
CONFIG_EFI_APP_64BIT=y
CONFIG_FIT=y
CONFIG_BOOTSTD_FULL=y
CONFIG_SHOW_BOOT_PROGRESS=y
CONFIG_USE_BOOTARGS=y
CONFIG_SYS_PBSIZE=532
CONFIG_SYS_CONSOLE_INFO_QUIET=y
CONFIG_LOG=y
CONFIG_BOARD_EARLY_INIT_R=y
CONFIG_CMD_BOOTZ=y
CONFIG_CMD_MEMINFO=y
CONFIG_CMD_MEMINFO_MAP=y
CONFIG_CMD_DM=y
CONFIG_CMD_LSBLK=y
CONFIG_CMD_DNS=y
CONFIG_CMD_WGET=y
CONFIG_CMD_CACHE=y
CONFIG_CMD_TIME=y
CONFIG_CMD_EXT4_WRITE=y
CONFIG_MAC_PARTITION=y
CONFIG_OF_LIVE=y
CONFIG_ENV_OVERWRITE=y
CONFIG_SYS_RELOC_GD_ENV_ADDR=y
CONFIG_USE_BOOTFILE=y
CONFIG_BOOTFILE="bzImage"
CONFIG_REGMAP=y
CONFIG_SYSCON=y
CONFIG_EFI_NET=y
CONFIG_DM_RNG=y
CONFIG_SYSRESET=y
CONFIG_VIDEO=y
CONFIG_SYS_WHITE_ON_BLACK=y
CONFIG_CONSOLE_SCROLL_LINES=5
CONFIG_CMD_DHRYSTONE=y
CONFIG_EFI_RAM_SIZE=0x20000000
# CONFIG_BOOTMETH_EFI_BOOTMGR is not set
CONFIG_OF_SYSTEM_SETUP=y
# CONFIG_CMDLINE is not set
# CONFIG_EXPO is not set
# CONFIG_VIDEO is not set
# CONFIG_ENV_SUPPORT is not set
# CONFIG_NET is not set
CONFIG_NO_NET=y
# CONFIG_EFI_LOADER is not set
# CONFIG_BOOTMETH_VBE is not set
# CONFIG_BOOTMETH_EXTLINUX_LOCALBOOT is not set
# CONFIG_BOOTMETH_DISTRO is not set

# BOOTSTD_DEFAULTS is not set
# CONFIG_BOOTSTD_FULL is not set
CONFIG_EFI_PARTITION=y
CONFIG_DOS_PARTITION=y
CONFIG_SUPPORT_RAW_INITRD=y

CONFIG_FS_EXT4=y
```

## configs/efi-arm_payload64_defconfig
```kconfig
CONFIG_ARM=y
CONFIG_ARCH_EFI_ARM=y
CONFIG_DEFAULT_DEVICE_TREE="efi-arm64_payload"
CONFIG_TARGET_EFI_ARM_PAYLOAD64=y

CONFIG_EFI_CLIENT=y
CONFIG_EFI_STUB=y
CONFIG_EFI_STUB_64BIT=y

CONFIG_PL01X_SERIAL=y
CONFIG_DEBUG_UART=y
CONFIG_DEBUG_UART_ANNOUNCE=y
CONFIG_DEBUG_UART_BASE=0x894000
#CONFIG_DEBUG_UART_NS16550=y
CONFIG_DEBUG_UART_CLOCK=14745600
# CONFIG_EFI_LOADER is not set
# CONFIG_DISPLAY_CPUINFO is not set
CONFIG_DEBUG_UART_PL011=y
```

## configs/efi-x86_app32_defconfig
```kconfig
CONFIG_X86=y
CONFIG_NR_DRAM_BANKS=8
CONFIG_ENV_SIZE=0x1000
CONFIG_DEFAULT_DEVICE_TREE="efi-x86_app"
CONFIG_DEBUG_UART_BASE=0x0
CONFIG_DEBUG_UART_CLOCK=0
CONFIG_ARCH_EFI_X86=y
CONFIG_DEBUG_UART=y
# CONFIG_AHCI is not set
CONFIG_TARGET_EFI_X86_APP32=y
CONFIG_EFI_CLIENT=y
CONFIG_FIT=y
CONFIG_BOOTSTD_FULL=y
CONFIG_SHOW_BOOT_PROGRESS=y
CONFIG_USE_BOOTARGS=y
CONFIG_BOOTARGS="root=/dev/sdb3 init=/sbin/init rootwait ro"
CONFIG_BOOTCOMMAND="bootflow scan -lbp"
CONFIG_SYS_PBSIZE=532
CONFIG_SYS_CONSOLE_INFO_QUIET=y
CONFIG_DISPLAY_BOARDINFO_LATE=y
CONFIG_CMD_TIME=y
CONFIG_CMD_EXT4_WRITE=y
CONFIG_MAC_PARTITION=y
CONFIG_ENV_OVERWRITE=y
CONFIG_SYS_RELOC_GD_ENV_ADDR=y
CONFIG_USE_BOOTFILE=y
CONFIG_BOOTFILE="bzImage"
CONFIG_NO_NET=y
CONFIG_REGMAP=y
CONFIG_SYSCON=y
# CONFIG_SCSI is not set
# CONFIG_GZIP is not set
```

## configs/firefly-rk3288_defconfig
```kconfig
+S:CONFIG_ARM=y
+S:CONFIG_ARCH_ROCKCHIP=y
+S:CONFIG_ROCKCHIP_RK3288=y
+S:CONFIG_TARGET_FIREFLY_RK3288=y
+S:CONFIG_DEFAULT_DEVICE_TREE="rk3288-firefly"
+S:CONFIG_DEBUG_UART=y
+S:CONFIG_DEBUG_UART_NS16550=y
+S:CONFIG_DEBUG_UART_BASE=0xff690000
+S:CONFIG_DEBUG_UART_CLOCK=24000000
+S:CONFIG_DEBUG_UART_SHIFT=2
CONFIG_USE_PRIVATE_LIBGCC=y
```

## configs/j721e_sk_a72_defconfig
```kconfig
#include <configs/j721e_evm_a72_defconfig>

CONFIG_DEFAULT_DEVICE_TREE="ti/k3-j721e-sk"
CONFIG_OF_LIST="ti/k3-j721e-sk"
```

## configs/ls1043aqds_nor_ddr3_defconfig
```kconfig
CONFIG_ARM=y
CONFIG_TARGET_LS1043AQDS=y
CONFIG_FIT=y
CONFIG_FIT_VERBOSE=y
CONFIG_OF_BOARD_SETUP=y
CONFIG_SYS_NS16550=y
CONFIG_OF_LIBFDT=y
```

## configs/mk802ii_defconfig
```kconfig
CONFIG_ARM=y
CONFIG_ARCH_SUNXI=y
CONFIG_SPL_I2C_SUPPORT=y
CONFIG_MACH_SUN4I=y
CONFIG_DEFAULT_DEVICE_TREE="sun4i-a10-mk802ii"
# CONFIG_SYS_MALLOC_CLEAR_ON_INIT is not set
CONFIG_SYS_CONSOLE_IS_IN_ENV=y
CONFIG_SPL=y
# CONFIG_CMD_IMLS is not set
# CONFIG_CMD_FLASH is not set
# CONFIG_CMD_FPGA is not set
CONFIG_USB_EHCI_HCD=y
CONFIG_CFB_CONSOLE=y
```

## configs/omap3_pandora_defconfig
```kconfig
CONFIG_ARM=y
CONFIG_OMAP34XX=y
CONFIG_TARGET_OMAP3_PANDORA=y
CONFIG_DM=y
CONFIG_DM_GPIO=y
CONFIG_DM_SERIAL=y
```

## configs/qemu_arm64_lwip_defconfig
```kconfig
#include <configs/qemu_arm64_defconfig>
CONFIG_NET_LWIP=y
CONFIG_CMD_DNS=y
CONFIG_CMD_WGET=y
CONFIG_EFI_HTTP_BOOT=y
CONFIG_CMD_EFIDEBUG=y
```

## configs/qemu_arm64_tpl_defconfig
```kconfig
CONFIG_ARM=y
CONFIG_POSITION_INDEPENDENT=y
CONFIG_ARCH_QEMU=y
CONFIG_TEXT_BASE=0x13000
CONFIG_SYS_MALLOC_LEN=0x1000000
CONFIG_NR_DRAM_BANKS=1
CONFIG_HAS_CUSTOM_SYS_INIT_SP_ADDR=y
CONFIG_CUSTOM_SYS_INIT_SP_ADDR=0x40200000
CONFIG_ENV_SIZE=0x40000
CONFIG_ENV_SECT_SIZE=0x40000
CONFIG_DEFAULT_DEVICE_TREE="qemu-arm64"
CONFIG_SPL_TEXT_BASE=0x40100000
CONFIG_TARGET_QEMU_ARM_64BIT_TPL=y
CONFIG_SPL_BSS_MAX_SIZE=0x10000
CONFIG_DEBUG_UART_BASE=0x9000000
CONFIG_DEBUG_UART_CLOCK=0
CONFIG_ARMV8_CRYPTO=y
CONFIG_SYS_LOAD_ADDR=0x40200000
CONFIG_ENV_ADDR=0x4000000
CONFIG_TPL_MAX_SIZE=0x10000
CONFIG_PCI=y
CONFIG_DEBUG_UART=y
CONFIG_AHCI=y
CONFIG_EFI_HTTP_BOOT=y
CONFIG_FIT=y
CONFIG_FIT_SIGNATURE=y
CONFIG_FIT_VERBOSE=y
CONFIG_FIT_BEST_MATCH=y
CONFIG_BOOTSTD_FULL=y
CONFIG_LEGACY_IMAGE_FORMAT=y
CONFIG_USE_PREBOOT=y
# CONFIG_PRE_CONSOLE_BUFFER is not set
# CONFIG_DISPLAY_CPUINFO is not set
# CONFIG_DISPLAY_BOARDINFO is not set
CONFIG_PCI_INIT_R=y
CONFIG_SPL_MAX_SIZE=0x10000
# CONFIG_SPL_SEPARATE_BSS is not set
CONFIG_TPL_RELOC_LOADER=y
CONFIG_CMD_SMBIOS=y
CONFIG_CMD_BOOTZ=y
CONFIG_CMD_BOOTEFI_SELFTEST=y
CONFIG_CMD_NVEDIT_EFI=y
CONFIG_CMD_DFU=y
CONFIG_CMD_MTD=y
CONFIG_CMD_PCI=y
CONFIG_CMD_EFIDEBUG=y
CONFIG_CMD_TPM=y
CONFIG_CMD_MTDPARTS=y
CONFIG_ENV_IS_IN_FLASH=y
CONFIG_SCSI_AHCI=y
CONFIG_AHCI_PCI=y
CONFIG_DFU_TFTP=y
CONFIG_DFU_MTD=y
CONFIG_DFU_RAM=y
# CONFIG_MMC is not set
CONFIG_MTD=y
CONFIG_DM_MTD=y
CONFIG_MTD_NOR_FLASH=y
CONFIG_FLASH_SHOW_PROGRESS=0
CONFIG_CFI_FLASH=y
CONFIG_CFI_FLASH_USE_WEAK_ACCESSORS=y
CONFIG_SYS_FLASH_USE_BUFFER_WRITE=y
CONFIG_FLASH_CFI_MTD=y
CONFIG_SYS_FLASH_CFI=y
CONFIG_SYS_MAX_FLASH_SECT=256
CONFIG_SYS_MAX_FLASH_BANKS=2
CONFIG_SYS_MAX_FLASH_BANKS_DETECT=y
CONFIG_E1000=y
CONFIG_NVME_PCI=y
CONFIG_PCIE_ECAM_GENERIC=y
CONFIG_SCSI=y
CONFIG_DEBUG_UART_PL011=y
CONFIG_DEBUG_UART_SHIFT=2
CONFIG_SYSRESET=y
CONFIG_SYSRESET_CMD_POWEROFF=y
CONFIG_SYSRESET_PSCI=y
CONFIG_TPM2_MMIO=y
CONFIG_USB_EHCI_HCD=y
CONFIG_USB_EHCI_PCI=y
# CONFIG_BINMAN_FDT is not set
CONFIG_SEMIHOSTING=y
CONFIG_TPM=y
CONFIG_TPL_LZ4=y
```

## configs/rk3399-generic_defconfig
```kconfig
CONFIG_ARM=y
CONFIG_SKIP_LOWLEVEL_INIT=y
CONFIG_COUNTER_FREQUENCY=24000000
CONFIG_ARCH_ROCKCHIP=y
CONFIG_TEXT_BASE=0x00200000
CONFIG_NR_DRAM_BANKS=1
CONFIG_HAS_CUSTOM_SYS_INIT_SP_ADDR=y
CONFIG_CUSTOM_SYS_INIT_SP_ADDR=0x300000
CONFIG_SF_DEFAULT_SPEED=20000000
CONFIG_ENV_OFFSET=0x3F8000
CONFIG_DEFAULT_DEVICE_TREE="rockchip/rk3399-firefly"
CONFIG_OF_LIST="rockchip/rk3399-evb rockchip/rk3399-ficus rockchip/rk3399-firefly rockchip/rk3399-gru-bob rockchip/rk3399-gru-kevin rockchip/rk3399-orangepi rockchip/rk3399-pinebook-pro rockchip/rk3399-pinephone-pro rockchip/rk3399-puma-haikou rockchip/rk3399-rockpro64 rockchip/rk3399-rockpro64-v2"
# CONFIG_OF_LIST="rockchip/rk3399-eaidk-610 rockchip/rk3399-evb rockchip/rk3399-ficus rockchip/rk3399-firefly rockchip/rk3399-gru-bob rockchip/rk3399-gru-kevin rockchip/rk3399-gru-scarlet-dumo rockchip/rk3399-gru-scarlet-inx rockchip/rk3399-gru-scarlet-kd rockchip/rk3399-hugsun-x99 rockchip/rk3399-khadas-edge-captain rockchip/rk3399-khadas-edge rockchip/rk3399-khadas-edge-v rockchip/rk3399-kobol-helios64 rockchip/rk3399-leez-p710 rockchip/rk3399-nanopc-t4 rockchip/rk3399-nanopi-m4b rockchip/rk3399-nanopi-m4 rockchip/rk3399-nanopi-neo4 rockchip/rk3399-nanopi-r4s rockchip/rk3399-nanopi-r4s-enterprise rockchip/rk3399-orangepi rockchip/rk3399-pinebook-pro rockchip/rk3399-pinephone-pro rockchip/rk3399pro-rock-pi-n10 rockchip/rk3399-puma-haikou rockchip/rk3399-rock-4c-plus rockchip/rk3399-rock-4se rockchip/rk3399-rock960 rockchip/rk3399-rock-pi-4a rockchip/rk3399-rock-pi-4a-plus rockchip/rk3399-rock-pi-4b rockchip/rk3399-rock-pi-4b-plus rockchip/rk3399-rock-pi-4c rockchip/rk3399-rockpro64 rockchip/rk3399-rockpro64-v2 rockchip/rk3399-roc-pc rockchip/rk3399-roc-pc-mezzanine rockchip/rk3399-roc-pc-plus rockchip/rk3399-sapphire
CONFIG_DM_RESET=y
CONFIG_ROCKCHIP_RK3399=y
CONFIG_TARGET_EVB_RK3399=y
CONFIG_SPL_STACK=0xff8eff00
CONFIG_DEBUG_UART_BASE=0xFF1A0000
CONFIG_DEBUG_UART_CLOCK=24000000
CONFIG_SYS_LOAD_ADDR=0x800800
CONFIG_PCI=y
CONFIG_DEBUG_UART=y
# CONFIG_SPL_FIT_SIGNATURE=y
# CONFIG_VPL_FIT_SIGNATURE=y
CONFIG_LEGACY_IMAGE_FORMAT=y
CONFIG_BOOTSTAGE=y
CONFIG_BOOTSTAGE_REPORT=y
CONFIG_USE_PREBOOT=y
CONFIG_DEFAULT_FDT_FILE="rockchip/rk3399-generic.dtb"
CONFIG_DISPLAY_BOARDINFO_LATE=y
CONFIG_SPL_MAX_SIZE=0x40000
CONFIG_SPL_PAD_TO=0x7f8000
CONFIG_SPL_BSS_START_ADDR=0x400000
CONFIG_SPL_BSS_MAX_SIZE=0x2000
# CONFIG_SPL_RAW_IMAGE_SUPPORT is not set
# CONFIG_SPL_SHARES_INIT_SP_ADDR is not set
CONFIG_SPL_STACK_R=y
CONFIG_SPL_STACK_R_MALLOC_SIMPLE_LEN=0x30000
CONFIG_SPL_SPI_LOAD=y
CONFIG_SYS_SPI_U_BOOT_OFFS=0xE0000
CONFIG_SPL_ATF_NO_PLATFORM_PARAM=y
CONFIG_TPL=y
CONFIG_CMD_BOOTZ=y
CONFIG_CMD_GPT=y
CONFIG_CMD_MMC=y
CONFIG_CMD_PCI=y
CONFIG_CMD_USB=y
# CONFIG_CMD_SETEXPR is not set
CONFIG_CMD_TIME=y
CONFIG_CMD_BOOTSTAGE=y
CONFIG_SPL_OF_CONTROL=y
CONFIG_OF_SPL_REMOVE_PROPS="pinctrl-0 pinctrl-names clock-names interrupt-parent assigned-clocks assigned-clock-rates assigned-clock-parents"
CONFIG_ENV_IS_IN_SPI_FLASH=y
CONFIG_SYS_RELOC_GD_ENV_ADDR=y
CONFIG_SPL_DM_SEQ_ALIAS=y
CONFIG_SATA=y
CONFIG_SCSI_AHCI=y
CONFIG_AHCI_PCI=y
CONFIG_SATA_SIL=y
CONFIG_ROCKCHIP_GPIO=y
CONFIG_SYS_I2C_ROCKCHIP=y
CONFIG_LED=y
CONFIG_LED_GPIO=y
CONFIG_MISC=y
CONFIG_ROCKCHIP_EFUSE=y
CONFIG_MMC_DW=y
CONFIG_MMC_DW_ROCKCHIP=y
CONFIG_MMC_SDHCI=y
CONFIG_MMC_SDHCI_SDMA=y
CONFIG_MMC_SDHCI_ROCKCHIP=y
CONFIG_PHY_REALTEK=y
CONFIG_DM_ETH_PHY=y
CONFIG_ETH_DESIGNWARE=y
CONFIG_GMAC_ROCKCHIP=y
CONFIG_NVME_PCI=y
CONFIG_PHY_ROCKCHIP_INNO_USB2=y
CONFIG_PHY_ROCKCHIP_TYPEC=y
CONFIG_PMIC_RK8XX=y
CONFIG_REGULATOR_PWM=y
CONFIG_REGULATOR_RK8XX=y
CONFIG_PWM_ROCKCHIP=y
CONFIG_BAUDRATE=1500000
CONFIG_DEBUG_UART_SHIFT=2
CONFIG_SYS_NS16550_MEM32=y
CONFIG_ROCKCHIP_SPI=y
CONFIG_SYSRESET=y
CONFIG_USB=y
CONFIG_USB_XHCI_HCD=y
CONFIG_USB_XHCI_DWC3=y
CONFIG_USB_EHCI_HCD=y
CONFIG_USB_EHCI_GENERIC=y
CONFIG_USB_OHCI_HCD=y
CONFIG_USB_OHCI_GENERIC=y
CONFIG_USB_DWC3=y
CONFIG_USB_DWC3_GENERIC=y
CONFIG_USB_KEYBOARD=y
CONFIG_USB_HOST_ETHER=y
CONFIG_USB_ETHER_ASIX=y
CONFIG_USB_ETHER_ASIX88179=y
CONFIG_USB_ETHER_MCS7830=y
CONFIG_USB_ETHER_RTL8152=y
CONFIG_USB_ETHER_SMSC95XX=y
CONFIG_VIDEO=y
CONFIG_DISPLAY=y
CONFIG_VIDEO_ROCKCHIP=y
CONFIG_DISPLAY_ROCKCHIP_HDMI=y
CONFIG_SPL_TINY_MEMSET=y
CONFIG_ERRNO_STR=y
CONFIG_VPL=y
CONFIG_CMD_VBE=y
CONFIG_BLOBLIST_ADDR=0xff8eff00
# CONFIG_VPL_CLK is not set
CONFIG_VPL_SYSCON=y
CONFIG_VPL_REGMAP=y
# CONFIG_VPL_LZMA is not set
CONFIG_VPL_LZ4=y
CONFIG_BLOBLIST_SIZE=0x100
# CONFIG_LOG=y
# CONFIG_LOG_ERROR_RETURN=y
# CONFIG_TPL_LOG=y
# CONFIG_TPL_SEPARATE_BSS is not set
CONFIG_SYS_MMCSD_RAW_MODE_U_BOOT_USE_SECTOR
CONFIG_SYS_MMCSD_RAW_MODE_U_BOOT_SECTOR=0x1000
# CONFIG_SYS_MMCSD_RAW_MODE_U_BOOT_USE_BINMAN=y
CONFIG_TPL_LZ4=y
# CONFIG_SPL_LZ4=y
# CONFIG_TPL_GZIP=y
CONFIG_TPL_RELOC_LOADER=y
# CONFIG_VPL_FIT_SIGNATURE is not set
# CONFIG_VPL_FIT is not set
# CONFIG_VPL_BOOTMETH_VBE is not set
# CONFIG_VPL_BOOTMETH_VBE_SIMPLE is not set
# CONFIG_VPL_BOOTMETH_VBE_SIMPLE_FW is not set
CONFIG_TPL_CRC8=y
CONFIG_TPL_SYS_MALLOC_F_LEN=0x4000
CONFIG_VPL_SYS_MALLOC_F_LEN=0x4000
CONFIG_VPL_LOAD_FIT=y
CONFIG_VPL_LOAD_FIT_FULL=y
CONFIG_TPL_DM_SEQ_ALIAS=y
CONFIG_BLOBLIST=y
CONFIG_VPL_BOOTMETH_VBE=y
CONFIG_VPL_BOOTMETH_VBE_SIMPLE_FW=y
CONFIG_VPL_BOOTMETH_VBE_SIMPLE=y
CONFIG_LOG=y
CONFIG_VPL_RELOC_LOADER=y
# CONFIG_VPL_BOOTSTD is not set
# CONFIG_VPL_SHA1 is not set
CONFIG_VPL_USE_TINY_PRINTF=y
# CONFIG_VPL_SYSRESET is not set
# CONFIG_LOG_ERROR_RETURN is not set
# CONFIG_VPL_LOG is not set
CONFIG_SPL_CLK=y
# CONFIG_SPL_SHA1 is not set
CONFIG_SPL_TEXT_BASE=0xff8c2000
# CONFIG_SPL_SEPARATE_BSS is not set
# CONFIG_SPL_LZ4 is not set
# CONFIG_SPL_DM_USB is not set
# CONFIG_SPL_DM_PMIC is not set
CONFIG_BOOTMETH_VBE_ABREC=y
# CONFIG_TPL_LOAD_FIT=y
CONFIG_FIT_BEST_MATCH=y
# CONFIG_BOOTMETH_VBE_SIMPLE is not set
# CONFIG_VPL_FIT_PRINT is not set
# CONFIG_VPL_SHA256 is not set
# CONFIG_SPL_DM_STATS=y
```

## configs/sdm845_mtp_defconfig
```kconfig
CONFIG_ARM=y
CONFIG_ARCH_SNAPDRAGON=y
CONFIG_SYS_TEXT_BASE=0x80080000
CONFIG_TARGET_SDM845_MTP=y
CONFIG_DEFAULT_DEVICE_TREE="sdm845-mtp"
CONFIG_DM_MMC=y
```

## configs/socfpga_socrates_defconfig
```kconfig
CONFIG_SPL=y
+S:CONFIG_ARM=y
+S:CONFIG_TARGET_SOCFPGA_CYCLONE5=y
CONFIG_OF_CONTROL=y
CONFIG_SPL_DISABLE_OF_CONTROL=y
CONFIG_DEFAULT_DEVICE_TREE="socfpga_cyclone5_socrates"
CONFIG_DM=y
CONFIG_DM_SPI=y
CONFIG_DM_SPI_FLASH=y
CONFIG_ETH_DESIGNWARE=y
CONFIG_NETDEVICES=y
CONFIG_NET=y
```

## configs/vexpress_fvp_bloblist_defconfig
```kconfig
#include <configs/vexpress_fvp_defconfig>

CONFIG_BLOBLIST=y
CONFIG_OF_PASSAGE=y
CONFIG_BLOBLIST_SIZE_RELOC=0x10000
CONFIG_BLOBLIST_PASSAGE=y
CONFIG_PASSAGE_IN=y
```

## configs/x1e_defconfig
```kconfig
#include "qcom_defconfig"

# Broken?? Probably an issue with mapping the memory
CONFIG_QCOM_COMMAND_DB=n

CONFIG_EFI=y
CONFIG_EFI_STUB=y
CONFIG_EFI_STUB_64BIT=y

CONFIG_DEBUG_UART=y
CONFIG_DEBUG_UART_ANNOUNCE=y
CONFIG_DEBUG_UART_BASE=0x894000
CONFIG_DEBUG_UART_MSM_GENI=y
CONFIG_DEBUG_UART_CLOCK=14745600

CONFIG_DEFAULT_ENV_FILE="board/qualcomm/efistub.env"
CONFIG_DEFAULT_DEVICE_TREE="qcom/x1e80100-crd"
#CONFIG_DEFAULT_DEVICE_TREE="qcom/x1p64100-acer-swift-sf14-11"
CONFIG_USB_KEYBOARD=y
CONFIG_HID_I2C=y
#CONFIG_PANIC_HANG=y
CONFIG_ERRNO_STR=y
# CONFIG_CONSOLE_PAGER=y
CONFIG_CMD_CONSOLE_EXTRA=y
```

## configs/x600_defconfig
```kconfig
CONFIG_SPL=y
+S:CONFIG_ARM=y
+S:CONFIG_TARGET_X600=y
CONFIG_ETH_DESIGNWARE=y
CONFIG_NETDEVICES=y
CONFIG_NET=y
```
