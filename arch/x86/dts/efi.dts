/*
 * Copyright (C) 2015, Simon Glass <sjg@chromium.org>
 *
 * SPDX-License-Identifier:	GPL-2.0+
 */

/dts-v1/;

/include/ "skeleton.dtsi"

/ {
	model = "EFI";
	compatible = "efi,payload";

	chosen {
		stdout-path = &serial;
	};

	serial: serial {
		compatible = "efi,uart";
	};
};
