// SPDX-License-Identifier: GPL-2.0
/dts-v1/;

#include "tegra30-asus-transformer.dtsi"

/ {
	model = "ASUS Transformer Prime TF201";
	compatible = "asus,tf201", "nvidia,tegra30";

	reserved-memory {
		#address-cells = <1>;
		#size-cells = <1>;
		ranges;

		memory@abc01000 {
			reg = <0xabc01000 2048000>;
			no-map;
		};
	};

	framebuffer@abc01000 {
		compatible = "simple-framebuffer";
		reg = <0xabc01000 2048000>;
		width = <1280>;
		height = <800>;
		stride = <2560>;
		format = "r5g6b5";
	};

	/delete-node/ host1x@50000000;
	/delete-node/ backlight;
	/delete-node/ panel;
	/delete-node/ regulator-pnl;
	/delete-node/ regulator-bl;
};
