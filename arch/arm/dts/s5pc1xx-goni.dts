/*
 * Samsung's S5PC110-based Goni board device tree source
 *
 * Copyright (c) 2014 Google, Inc
 *
 * SPDX-License-Identifier:	GPL-2.0+
 */

/dts-v1/;

#include "skeleton.dtsi"
#include "s5pc110-pinctrl.dtsi"

/ {
	model = "Samsung Goni based on S5PC110";
	compatible = "samsung,goni", "samsung,s5pc110";

	aliases {
		serial0 = "/serial@e2900000";
		console = "/serial@e2900000";
		pinctrl0 = &pinctrl0;
	};

	pinctrl0: pinctrl@e0200000 {
		compatible = "samsung,s5pc100-pinctrl";
		reg = <0xe0200000 0x1000>;
	};

	serial@e2900000 {
		compatible = "samsung,exynos4210-uart";
		reg = <0xe2900000 0x100>;
		interrupts = <0 51 0>;
		id = <0>;
	};
};
