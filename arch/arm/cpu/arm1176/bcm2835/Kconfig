## board/freescale/common/Kconfig
```kconfig
config CHAIN_OF_TRUST
	depends on !FIT_SIGNATURE && SECURE_BOOT
	imply CMD_BLOB
	imply CMD_HASH
	select FSL_CAAM
	bool
	default y

config CMD_ESBC_VALIDATE
	bool "Enable the 'esbc_validate' and 'esbc_halt' commands"
	default y if CHAIN_OF_TRUST
	help
	  This option enables two commands used for secure booting:

	    esbc_validate - validate signature using RSA verification
	    esbc_halt - put the core in spin loop (Secure Boot Only)
```

## board/google/chromebook_link/Kconfig
```kconfig
if TARGET_CHROMEBOOK_LINK

config SYS_BOARD
	default "chromebook_link"

config SYS_VENDOR
	default "google"

config SYS_SOC
	default "ivybridge"

config SYS_CONFIG_NAME
	default "chromebook_link"

config BOARD_SPECIFIC_OPTIONS # dummy
	def_bool y
	select CPU_INTEL_SOCKET_RPGA989
	select NORTHBRIDGE_INTEL_IVYBRIDGE
	select SOUTHBRIDGE_INTEL_C216

config MMCONF_BASE_ADDRESS
	hex
	default 0xf0000000

endif
```

## board/logicpd/am3517evm/Kconfig
```kconfig
if TARGET_AM3517_EVM

config SYS_BOARD
	default "am3517evm"

config SYS_VENDOR
	default "logicpd"

config SYS_CONFIG_NAME
	default "am3517_evm"

config DM
	default y

config DM_GPIO
	default y

config DM_SERIAL
	default y

endif
```

## board/logicpd/omap3som/Kconfig
```kconfig
if TARGET_OMAP3_LOGIC

config SYS_BOARD
	default "omap3som"

config SYS_VENDOR
	default "logicpd"

config SYS_CONFIG_NAME
	default "omap3_logic"

config DM
	default y

config DM_GPIO
	default y

config DM_SERIAL
	default y

endif
```

## board/overo/Kconfig
```kconfig
if TARGET_OMAP3_OVERO

config SYS_BOARD
	default "overo"

config SYS_CONFIG_NAME
	default "omap3_overo"

config DM
	default y

config DM_GPIO
	default y

config DM_SERIAL
	default y

endif
```

## board/qualcomm/sdm845_mtp/Kconfig
```kconfig
if TARGET_SDM845_MTP

config SYS_BOARD
	default "sdm845_mtp"

config SYS_VENDOR
	default "qualcomm"

config SYS_SOC
	default "sda845"

config SYS_CONFIG_NAME
	default "sdm845_mtp"

endif
```

## board/sandbox/Kconfig
```kconfig
if TARGET_SANDBOX

config SYS_CONFIG_NAME
	string
	default "sandbox"

endif

if TARGET_CHROMEOS_SANDBOX

config SYS_CONFIG_NAME
	string
	default "chromeos_sandbox"

endif
```
