## arch/arm/cpu/arm1176/bcm2835/Kconfig
```kconfig
if TARGET_RPI_B

config DM
	default y

config DM_SERIAL
	default y

config DM_GPIO
	default y

endif
```

## arch/arm/cpu/armv7/tegra-common/Kconfig
```kconfig
if TEGRA

choice
	prompt "Tegra SoC select"

config TEGRA20
	bool "Tegra20 family"

config TEGRA30
	bool "Tegra30 family"

config TEGRA114
	bool "Tegra114 family"

config TEGRA124
	bool "Tegra124 family"

endchoice

config USE_PRIVATE_LIBGCC
	default y if SPL_BUILD

config DM
	default y

config SPL_DM
	default y

config DM_SERIAL
	default y

config DM_SPI
	default y

config DM_SPI_FLASH
	default y

config DM_I2C
	default y

config DM_GPIO
	default y

source "arch/arm/cpu/armv7/tegra20/Kconfig"
source "arch/arm/cpu/armv7/tegra30/Kconfig"
source "arch/arm/cpu/armv7/tegra114/Kconfig"
source "arch/arm/cpu/armv7/tegra124/Kconfig"

endif
```

## arch/arm/lib/Kconfig
```kconfig
config SEMIHOSTING
        bool "Semihosting"
	depends on ARCH_HAVE_SEMIHOSTING
        help
          Add semihosting support. This allows u-boot to load binaries
	  from host via semihost.
```

## arch/arm/mach-qemu/Kconfig
```kconfig
if ARCH_QEMU

config SYS_VENDOR
	default "emulation"

config SYS_BOARD
	default "qemu-arm"

config SYS_CONFIG_NAME
	default "qemu-arm"

choice
	prompt "QEMU ARM architecture"
	default TARGET_QEMU_ARM_64BIT

config TARGET_QEMU_ARM_32BIT
	bool "ARMv7-A, 32bit"
	select ARCH_SUPPORT_PSCI
	select BOARD_LATE_INIT
	select CPU_V7A
	select SYS_ARCH_TIMER

config TARGET_QEMU_ARM_64BIT
	bool "ARMv8, 64bit"
	select ARM64
	select BOARD_LATE_INIT

config TARGET_QEMU_ARM_64BIT_TPL
	bool "ARMv8, 64bit, with TPL"
	select ARM64
	select BOARD_LATE_INIT
	select SPL
	select TPL
	select SPL_LIBCOMMON_SUPPORT
	select TPL_LIBCOMMON_SUPPORT
	select SPL_LIBGENERIC_SUPPORT
	select TPL_LIBGENERIC_SUPPORT
	select SPL_OF_CONTROL
	select TPL_OF_CONTROL
	select SPL_DM
	select TPL_DM
	select BINMAN
	select SPL_SERIAL
	select TPL_SERIAL
	imply SPL_FRAMEWORK_BOARD_INIT_F
	imply RPL_FRAMEWORK_BOARD_INIT_F

endchoice

endif
```

## arch/arm/mach-rockchip/rk3368/Kconfig
```kconfig
if ROCKCHIP_RK3368

config TARGET_GEEKBOX
	bool "GeekBox"

config SYS_SOC
	default "rockchip"

source "board/geekbuying/geekbox/Kconfig"

endif
```

## arch/arm/mach-snapdragon/Kconfig
```kconfig
if ARCH_SNAPDRAGON

config SYS_SOC
	default "snapdragon"

config SYS_MALLOC_F_LEN
	default 0x2000

config SPL_SYS_MALLOC_F_LEN
	default 0x2000

choice
	prompt "Snapdragon board select"

config TARGET_DRAGONBOARD410C
	bool "96Boards Dragonboard 410C"
	select BOARD_LATE_INIT
	select SOC_APQ8016
	help
	  Support for 96Boards Dragonboard 410C. This board complies with
	  96Board Open Platform Specifications. Features:
	  - Qualcomm Snapdragon 410C SoC - APQ8016 (4xCortex A53, Adreno 306)
	  - 1GiB RAM
	  - 8GiB eMMC, uSD slot
	  - WiFi, Bluetooth and GPS module
	  - 2x Host, 1x Device USB port
	  - HDMI
	  - 20-pin low speed and 40-pin high speed expanders, 4 LED, 3 buttons

config TARGET_DRAGONBOARD820C
	bool "96Boards Dragonboard 820C"
	select SOC_APQ8096
	help
	  Support for 96Boards Dragonboard 820C. This board complies with
	  96Board Open Platform Specifications. Features:
	  - Qualcomm Snapdragon 820C SoC - APQ8096 (4xKyro CPU)
	  - 3GiB RAM
	  - 32GiB UFS drive

config TARGET_SDM845_MTP
	bool "Snapdragon 845 Mobile Technology Platform"
	select SOC_SDA845
	help
	  Support for Qualcomm's MTP for the 845 SoC, including quad-core
	  Kryo 385 CPU, Adreno 630 GPU, Hexagon 685 DSP, 6GB SDRAM, 128GB UFS
	  storage, Wi-Fi and Bluetooth. This kit provides a development
	  platform for the Qualcomm Snapdragon 845 SoC.

endchoice

config SOC_APQ8016
	bool
	select SOC_APQ

config SOC_APQ8096
	bool

config SOC_APQ
	bool

config SOC_SDA845
	bool

source "board/qualcomm/dragonboard410c/Kconfig"
source "board/qualcomm/dragonboard820c/Kconfig"
source "board/qualcomm/sdm845_mtp/Kconfig"

endif
```

## arch/sandbox/Kconfig
```kconfig
menu "Sandbox architecture"
	depends on SANDBOX

config SYS_ARCH
	default "sandbox"

config SYS_BOARD
	default "sandbox"

config SYS_CONFIG_NAME
	default "sandbox"

config DM
	default y

config DM_GPIO
	default y

config DM_SERIAL
	default y

config CMD_DEMO
	default y

config CMD_DM
	default y

config DM_DEMO
	default y

config DM_DEMO_SIMPLE
	default y

config DM_DEMO_SHAPE
	default y

config DM_TEST
	default y

config DM_CROS_EC
	default y

config DM_SPI
	default y

config DM_SPI_FLASH
	default y

config DM_I2C
	default y

endmenu
```

## arch/x86/Kconfig
```kconfig
menu "x86 architecture"
	depends on X86

config SYS_ARCH
	default "x86"

config USE_PRIVATE_LIBGCC
	default y

choice
	prompt "Target select"

config TARGET_COREBOOT
	bool "Support coreboot"

config TARGET_CHROMEBOOK_LINK
	bool "Support Chromebook link"

endchoice

source "arch/x86/cpu/ivybridge/Kconfig"

source "board/chromebook-x86/coreboot/Kconfig"

source "board/google/chromebook_link/Kconfig"

endmenu
```

## arch/x86/cpu/ivybridge/Kconfig
```kconfig
#
# From Coreboot src/northbridge/intel/sandybridge/Kconfig
#
# Copyright (C) 2010 Google Inc.
#
# SPDX-License-Identifier:	GPL-2.0


config NORTHBRIDGE_INTEL_SANDYBRIDGE
	bool
	select CACHE_MRC_BIN
	select CPU_INTEL_MODEL_206AX

config NORTHBRIDGE_INTEL_IVYBRIDGE
	bool
	select CACHE_MRC_BIN
	select CPU_INTEL_MODEL_306AX

if NORTHBRIDGE_INTEL_SANDYBRIDGE

config VGA_BIOS_ID
	string
	default "8086,0106"

config CACHE_MRC_SIZE_KB
	int
	default 256

# TODO: build from rom size
config MRC_CACHE_BASE
	hex
	default 0xff800000

config MRC_CACHE_LOCATION
	hex
	depends on !CHROMEOS
	default 0x1ec000

config MRC_CACHE_SIZE
	hex
	depends on !CHROMEOS
	default 0x10000

config DCACHE_RAM_BASE
	hex
	default 0xff7f0000

config DCACHE_RAM_SIZE
	hex
	default 0x10000

endif

if NORTHBRIDGE_INTEL_IVYBRIDGE

config VGA_BIOS_ID
	string
	default "8086,0166"

config EXTERNAL_MRC_BLOB
	bool
	default n

config CACHE_MRC_SIZE_KB
	int
	default 512

# TODO: build from rom size
config MRC_CACHE_BASE
	hex
	default 0xff800000

config MRC_CACHE_LOCATION
	hex
	depends on !CHROMEOS
	default 0x370000

config MRC_CACHE_SIZE
	hex
	depends on !CHROMEOS
	default 0x10000

config DCACHE_RAM_BASE
	hex
	default 0xff7e0000

config DCACHE_RAM_SIZE
	hex
	default 0x20000

endif

if NORTHBRIDGE_INTEL_SANDYBRIDGE || NORTHBRIDGE_INTEL_IVYBRIDGE

config DCACHE_RAM_MRC_VAR_SIZE
	hex
	default 0x4000

config HAVE_MRC
	bool "Add a System Agent binary"
	help
	  Select this option to add a System Agent binary to
	  the resulting coreboot image.

	  Note: Without this binary coreboot will not work

config MRC_FILE
	string "Intel System Agent path and filename"
	depends on HAVE_MRC
	default "systemagent-ivybridge.bin" if NORTHBRIDGE_INTEL_IVYBRIDGE
	default "systemagent-sandybridge.bin" if NORTHBRIDGE_INTEL_SANDYBRIDGE
	help
	  The path and filename of the file to use as System Agent
	  binary.

config CBFS_SIZE
	hex "Size of CBFS filesystem in ROM"
	default 0x100000
	help
	  On Sandybridge and Ivybridge systems the firmware image has to
	  store a lot more than just coreboot, including:
	   - a firmware descriptor
	   - Intel Management Engine firmware
	   - MRC cache information
	  This option allows to limit the size of the CBFS portion in the
	  firmware image.

config CPU_SPECIFIC_OPTIONS
	def_bool y
	select SMM_TSEG
	select ARCH_BOOTBLOCK_X86_32
	select ARCH_ROMSTAGE_X86_32
	select ARCH_RAMSTAGE_X86_32
	select SMP
	select SSE2
	select UDELAY_LAPIC
	select CPU_MICROCODE_IN_CBFS
	#select AP_IN_SIPI_WAIT
	select TSC_SYNC_MFENCE

config SMM_TSEG_SIZE
	hex
	default 0x800000

config ENABLE_VMX
	bool "Enable VMX for virtualization"
	default n

endif

config CPU_INTEL_SOCKET_RPGA989
	bool

if CPU_INTEL_SOCKET_RPGA989

config SOCKET_SPECIFIC_OPTIONS # dummy
	def_bool y
	select MMX
	select SSE
	select CACHE_AS_RAM

config CACHE_MRC_BIN
	bool
	default n

endif
```

## board/Arcturus/ucp1020/Kconfig
```kconfig
# This exists only to avoid a warning for an unconverted value
if TARGET_UCP1020_SPIFLASH
config UCBOOT
	bool
	default y

config SPIFLASH
	bool
	default y
endif
```

## board/armltd/vexpress64/Kconfig
```kconfig
if TARGET_VEXPRESS_AEMV8A

config SYS_BOARD
	default "vexpress64"

config SYS_VENDOR
	default "armltd"

config SYS_CONFIG_NAME
	default "vexpress_aemv8a"

config BASE_FVP
	bool "Fast Models (FVP Base and/or VE)"
	help
	  Select Fast Models (FVP Base and/or VE).

endif
```

## board/efi/Kconfig
```kconfig
config ARCH_EFI
	bool
	select OF_CONTROL
	select DM_SERIAL

if ARCH_EFI

if X86

choice
	prompt "Mainboard model"
	optional

config TARGET_EFI_X86_APP32
	bool "32-bit efi application"
	select EFI_APP
	help
	  This target is used for running U-Boot on top of EFI. In
	  this case EFI does the early initialisation, and U-Boot
	  starts once the RAM, video and CPU are fully running.
	  U-Boot is loaded as an application from EFI.

config TARGET_EFI_X86_APP64
	bool "64-bit efi application"
	select EFI_APP
	select X86_64 if X86
	help
	  This target is used for running U-Boot on top of EFI in 64-bit mode.
	  In this case EFI does the early initialisation, and U-Boot
	  starts once the RAM, video and CPU are fully running.
	  U-Boot is loaded as an application from EFI.

config TARGET_EFI_X86_PAYLOAD
	bool "efi payload"
	help
	  This target is used for running U-Boot on top of EFI. In
	  this case EFI does the early initialisation, and U-Boot
	  takes over once the RAM, video and CPU are fully running.
	  U-Boot is loaded as a payload from EFI.

endchoice

source "board/efi/efi-x86_app/Kconfig"
source "board/efi/efi-x86_payload/Kconfig"

endif  # X86

if ARM

choice
	prompt "Mainboard model"
	optional

config TARGET_EFI_ARM_APP64
	bool "64-bit efi application"
	select EFI_APP
	select SYS_CUSTOM_LDSCRIPT
	select ARM64
	help
	  This target is used for running U-Boot on top of EFI in 64-bit mode.
	  In this case EFI does the early initialisation, and U-Boot
	  starts once the RAM, video and CPU are fully running.
	  U-Boot is loaded as an application from EFI.

config TARGET_EFI_ARM_PAYLOAD64
	bool "64-bit efi payload"
	select SYS_CUSTOM_LDSCRIPT
	select ARM64
	help
	  This target is used for running U-Boot on top of EFI. In
	  this case EFI does the early initialisation, and U-Boot
	  takes over once the RAM, video and CPU are fully running.
	  U-Boot is loaded as a payload from EFI.

endchoice

source "board/efi/efi-arm_app/Kconfig"
source "board/efi/efi-arm_payload/Kconfig"

endif  # ARM

endif  # ARCH_EFI
```

## board/efi/efi-arm_app/Kconfig
```kconfig
if EFI_APP

config SYS_BOARD
	default "efi-arm_app"

config SYS_VENDOR
	default "efi"

config SYS_SOC
	default "efi"

config BOARD_SPECIFIC_OPTIONS # dummy
	def_bool y
	imply VIDEO_EFI

config SYS_LDSCRIPT
	default "arch/arm/lib/elf_aarch64_efi.lds"

endif
```

## board/efi/efi-arm_payload/Kconfig
```kconfig
if TARGET_EFI_ARM_PAYLOAD64

config SYS_BOARD
	default "efi-arm_payload"

config SYS_VENDOR
	default "efi"

config SYS_SOC
	default "efi"

config TEXT_BASE
	default 0x00200000

config BOARD_SPECIFIC_OPTIONS # dummy
	def_bool y
	select BOARD_EARLY_INIT_R
	imply SYS_NS16550

config SYS_LDSCRIPT
	default "arch/arm/lib/elf_aarch64_efi.lds"

endif
```

## board/efi/efi-x86/Kconfig
```kconfig
if TARGET_EFI

config SYS_BOARD
	default "efi-x86"

config SYS_VENDOR
	default "efi"

config SYS_SOC
	default "efi"

config SYS_CONFIG_NAME
        default "efi-x86"

config SYS_CAR_ADDR
        hex "Board specific Cache-As-RAM (CAR) address"
        default 0x01920000
        help
          This option specifies the board specific Cache-As-RAM (CAR) address.

config SYS_CAR_SIZE
        hex "Board specific Cache-As-RAM (CAR) size"
        default 0x4000
        help
          This option specifies the board specific Cache-As-RAM (CAR) size.

endif
```

## board/emulation/Kconfig
```kconfig
# SPDX-License-Identifier: GPL-2.0+
#
# Copyright (C) 2015, Bin Meng <bmeng.cn@gmail.com>

if ARCH_QEMU_ARM

config SYS_VENDOR
	default "emulation"

choice
	prompt "QEMU ARM architecture"
	default TARGET_QEMU_ARM_64BIT

config TARGET_QEMU_ARM_32BIT
	bool "ARMv7-A, 32bit"
	select ARCH_SUPPORT_PSCI
	select BOARD_LATE_INIT
	select CPU_V7A
	select SYS_ARCH_TIMER

config TARGET_QEMU_ARM_32BIT_SPL
	bool "ARMv7-A, 32bit with SPL"
	select ARCH_SUPPORT_PSCI
	select BOARD_LATE_INIT
	select CPU_V7A
	select SYS_ARCH_TIMER
	select SPL
	select BINMAN

config TARGET_QEMU_ARM_64BIT
	bool "ARMv8, 64bit"
	select ARM64
	select BOARD_LATE_INIT

config TARGET_QEMU_ARM_SBSA
	bool "SBSA Reference"
	select ARM64
	select BINMAN
	select BOARD_LATE_INIT
	select ENABLE_ARM_SOC_BOOT0_HOOK
	select MISC_INIT_R

config TARGET_QEMU_ARM_64BIT_SPL
	bool "ARMv8, 64bit with SPL"
	select ARM64
	select BOARD_LATE_INIT
	select SPL
	select BINMAN

endchoice

if TARGET_QEMU_ARM_32BIT || TARGET_QEMU_ARM_64BIT || \
	TARGET_QEMU_ARM_32BIT_SPL || TARGET_QEMU_ARM_64BIT_SPL

config SYS_BOARD
	default "qemu-arm"

config SYS_CONFIG_NAME
	default "qemu-arm"

endif

if TARGET_QEMU_ARM_SBSA

config SYS_BOARD
	default "qemu-sbsa"

config SYS_CONFIG_NAME
	default "qemu-sbsa"

config SYS_SOC
	default "qemu-sbsa"

endif

source "board/emulation/qemu-arm/Kconfig"
source "board/emulation/qemu-sbsa/Kconfig"

endif  # ARCH_QEMU_ARM


if ARCH_QEMU_X86

choice
	prompt "Mainboard model"

config TARGET_QEMU_X86
	bool "QEMU x86"
	help
	  This is the QEMU emulated x86 board. U-Boot supports running
	  as a coreboot payload as well as bare boot without coreboot.
	  There are two types of x86 boards supported by QEMU which are
	  supported by U-Boot. They are via QEMU '-M pc', an i440FX/PIIX
	  chipset platform and '-M q35', a Q35/ICH9 chipset platform.

config TARGET_QEMU_X86_64
	bool "QEMU x86 64-bit"
	help
	  This is the QEMU emulated x86 64-bit board. With this config
	  U-Boot is built as a 64-bit binary. This allows testing while
	  this feature is being completed.

endchoice

source "board/emulation/qemu-x86/Kconfig"

endif  # ARCH_QEMU_X86
```

## board/emulation/common/Kconfig
```kconfig
config MTDPARTS_NOR0
	string "mtd boot partition for nor0"
	default "64m(u-boot)" if TARGET_QEMU_ARM_64BIT && !TFABOOT
	depends on SYS_MTDPARTS_RUNTIME
	help
	  This define the partition of nor0 used to build mtparts dynamically
	  for boot from nor0.

config MTDPARTS_NOR1
	string "mtd u-boot env partition for nor1"
	default "64m(u-boot-env)" if TARGET_QEMU_ARM_64BIT && !TFABOOT
	depends on SYS_MTDPARTS_RUNTIME
	help
	  This define the partition of nor1 used to build mtparts dynamically
	  for the u-boot env stored on nor1.

config QEMU_MANUAL_DTB
	bool "Manually provide a device tree to QEMU"
	help
	  For some use cases, such as FIT validation where a public key must be
	  placed in U-Boot's device tree, we need to override the device tree
	  that QEMU would normally provide to us.

	  Note: this work-around is necessary since Linaro has blocked
	  addition of a feature to support additions to the QEMU devicetree:

	    Link: https://patchwork.kernel.org/project/qemu-devel/patch/20210926183410.256484-1-sjg@chromium.org/#24481799
```

## board/emulation/qemu-arm/Kconfig
```kconfig
if ARCH_QEMU

config BOARD_SPECIFIC_OPTIONS # dummy
	def_bool y
	select HAS_CUSTOM_SYS_INIT_SP_ADDR
	select QFW if ACPI
	select QFW_MMIO
	select SUPPORT_SPL

config PRE_CON_BUF_ADDR
	hex
	default 0x40100000

endif

if TARGET_QEMU_ARM_32BIT || TARGET_QEMU_ARM_64BIT

config TEXT_BASE
	default 0x00000000

endif

if TARGET_QEMU_ARM_64BIT && !TFABOOT
config BOARD_SPECIFIC_OPTIONS
	imply SYS_MTDPARTS_RUNTIME
	imply SET_DFU_ALT_INFO

source "board/emulation/common/Kconfig"
endif

if TARGET_QEMU_ARM_32BIT_SPL

config SPL_TEXT_BASE
	default 0x00000000

config TEXT_BASE
	default 0x00010000

endif
```
