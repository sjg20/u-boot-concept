// SPDX-License-Identifier: GPL-2.0+
/*
 * Other devicetree file for running sandbox tests
 *
 * This used for tests which want to check they can access multiple device
 * trees. This one is loaded and checks are made that it is actually visible.
 */

/dts-v1/;

/ {
	compatible = "sandbox-other";

	node {
		target = <&target>;
	};

	target: target {
		str-prop = "other";
	};
};
