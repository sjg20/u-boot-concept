## drivers/block/Kconfig
```kconfig
config DISK
	bool "Support disk controllers with driver model"
	depends on DM
	default y if DM
	help
	  This enables a uclass for disk controllers in U-Boot. Various driver
	  types can use this, such as AHCI/SATA. It does not provide any standard
	  operations at present. The block device interface has not been converted
	  to driver model.

config DWC_AHCI
	bool "Enable Synopsys DWC AHCI driver support"
	depends on DISK
	help
	  Enable this driver to support Sata devices through
	  Synopsys DWC AHCI module.
```

## drivers/core/Kconfig
```kconfig
config DM
	bool "Enable Driver Model"
	depends on !SPL_BUILD
	help
	  This config option enables Driver Model. This brings in the core
	  support, including scanning of platform data on start-up. If
	  CONFIG_OF_CONTROL is enabled, the device tree will be scanned also
	  when available.

config DM_SERIAL
	bool "Enable Driver Model for serial"
	depends on DM
	help
	  Enable driver model for serial. This replaces
	  drivers/serial/serial.c with the serial uclass, which
	  implements serial_putc() etc. The uclass interface is
	  defined in include/serial.h.

config DM_GPIO
	bool "Enable Driver Model for GPIO"
	depends on DM
	help
	  Enable driver model for GPIO access. The standard GPIO
	  interface (gpio_get_value(), etc.) is then implemented by
	  the GPIO uclass. Drivers provide methods to query the
	  particular GPIOs that they provide. The uclass interface
	  is defined in include/asm-generic/gpio.h.

config DM_SPI
	bool "Enable Driver Model for SPI"
	depends on DM
	help
	  Enable driver model for SPI. The SPI slave interface
	  (spi_setup_slave(), spi_xfer(), etc.) is then implemented by
	  the SPI uclass. Drivers provide methods to access the SPI
	  buses that they control. The uclass interface is defined in
	  include/spi.h. The existing spi_slave structure is attached
	  as 'parent data' to every slave on each bus. Slaves
	  typically use driver-private data instead of extending the
	  spi_slave structure.

config DM_I2C
	bool "Enable Driver Model for I2C"
	depends on DM
	help
	  Enable driver model for I2C. This SPI flash interface
	  (spi_flash_probe(), spi_flash_write(), etc.) is then
	  implemented by the SPI flash uclass. There is one standard
	  SPI flash driver which knows how to probe most chips
	  supported by U-Boot. The uclass interface is defined in
	  include/spi_flash.h, but is currently fully compatible
	  with the old interface to avoid confusion and duplication
	  during the transition parent. SPI and SPI flash must be
	  enabled together (it is not possible to use driver model
	  for one and not the other).

config DM_SPI_FLASH
	bool "Enable Driver Model for SPI flash"
	depends on DM && SPI
	help
	  Enable driver model for SPI flash. This SPI flash interface
	  (spi_flash_probe(), spi_flash_write(), etc.) is then
	  implemented by the SPI flash uclass. There is one standard
	  SPI flash driver which knows how to probe most chips
	  supported by U-Boot. The uclass interface is defined in
	  include/spi_flash.h, but is currently fully compatible
	  with the old interface to avoid confusion and duplication
	  during the transition parent. SPI and SPI flash must be
	  enabled together (it is not possible to use driver model
	  for one and not the other).

config DM_CROS_EC
	bool "Enable Driver Model for Chrome OS EC"
	depends on DM
	help
	  Enable driver model for the Chrome OS EC interface. This
	  allows the cros_ec SPI driver to operate with CONFIG_DM_SPI
	  but otherwise makes few changes. Since cros_ec also supports
	  I2C and LPC (which don't support driver model yet), a full
	  conversion is not yet possible.

config SPL_DM
	bool "Enable Driver Model for SPL"
	depends on DM && SPL
	help
	  Enable driver model in SPL. You will need to provide a
	  suitable malloc() implementation. If you are not using the
	  full malloc() enabled by CONFIG_SYS_SPL_MALLOC_START,
	  consider using CONFIG_SYS_MALLOC_SIMPLE. In that case you
	  must provide CONFIG_SYS_MALLOC_F_LEN to set the size.
	  In most cases driver model will only allocate a few uclasses
	  and devices in SPL, so 1KB should be enable. See
	  CONFIG_SYS_MALLOC_F_LEN for more details on how to enable it.

config DM_WARN
	bool "Enable warnings in driver model"
	help
	  The dm_warn() function can use up quite a bit of space for its
	  strings. By default this is disabled for SPL builds to save space.
	  This will cause dm_warn() to be compiled out - it will do nothing
	  when called.
	depends on DM
	default y if !SPL_BUILD
	default n if SPL_BUILD

config DM_DEVICE_REMOVE
	bool "Support device removal"
	help
	  We can save some code space by dropping support for removing a
	  device. This is not normally required in SPL, so by default this
	  option is disabled for SPL.
	depends on DM
	default y if !SPL_BUILD
	default n if SPL_BUILD

config DM_STDIO
	bool "Support stdio registration"
	help
	  Normally serial drivers register with stdio so that they can be used
	  as normal output devices. In SPL we don't normally use stdio, so
	  we can omit this feature.
	depends on DM
	default y if !SPL_BUILD
	default n if SPL_BUILD
```

## drivers/crypto/Kconfig
```kconfig
menuconfig CRYPTO
	 bool "Hardware crypto devices"
	 default y
	 help
	   Enable support for hardware-accerlated cryptographic devices.

	   Note that this option is a misnomer since CRYPTO suggests that
	   software devices/implementations should be included in the
	   option.

if CRYPTO

source drivers/crypto/fsl/Kconfig

endif
```

## drivers/file/Kconfig
```kconfig
# SPDX-License-Identifier: GPL-2.0+

# Implementation of files containing data
#
# Copyright 2025 Canonical Ltd
# Written by Simon Glass <simon.glass@canonical.com>
#

config FILE
	bool "Support file layer"
	help
	  Enables support for files which can be accessed, read and written
	  as objects.
```

## drivers/iommu/Kconfig
```kconfig
#
# IOMMU devices
#

menu "IOMMU device drivers"

config IOMMU
	bool "Enable Driver Model for IOMMU drivers"
	depends on DM
	help
	  Enable driver model for IOMMU devices.

config APPLE_DART
	bool "Apple DART support"
	depends on IOMMU && ARCH_APPLE
	default y
	help
	  Enable support for the DART on Apple SoCs.  The DART is Apple's
	  IOMMU implementation.  The driver performs the necessary
	  configuration to put the DART into bypass mode such that it can
	  be used transparently by U-Boot.

endmenu
```

## drivers/net/Kconfig
```kconfig
config DM_ETH
	bool "Enable Driver Model for Ethernet drivers"
	depends on DM
	help
	  Enable driver model for Ethernet.

menuconfig NETDEVICES
	bool "Network device support"
	depends on NET
	help
	  You must select Y to enable any network device support
	  Generally if you have any networking support this is a given

	  If unsure, say Y

if NETDEVICES

config ETH_SANDBOX
	depends on DM_ETH && SANDBOX
	default y
	bool "Sandbox: Mocked Ethernet driver"

config ETH_SANDBOX_RAW
	depends on DM_ETH && SANDBOX
	default y
	bool "Sandbox: Bridge to Linux Raw Sockets"

config ETH_DESIGNWARE
	bool "Synopsys Designware Ethernet MAC"
	help
	  This MAC is present in SoCs from various vendors. It supports
	  100Mbit and 1 Gbit operation. You must enable CONFIG_PHYLIB to
	  provide the PHY (physical media interface).

endif # NETDEVICES
```

## drivers/pinctrl/Kconfig
```kconfig
config PINCTRL
	bool "Pin multiplexing driver support"
	help
	  Support pin multiplexing control in U-Boot. Most SoCs have their own
	  own multiplexing arrangement where a single pin can be used for
	  several functions. An SoC pinctrl driver allows the required
	  function to be selected for each pin. The driver is typically
	  controlled by the device tree.

config SPL_PINCTRL_SUPPORT
	bool "Enable pin multiplexing (pinctrl) support in SPL"
	depends on PINCTRL
	help
	  The pinctrl subsystem can add a substantial overhead to the SPL
	  image since it typically requires quite a few tables either in the
	  driver or in the device tree. If this is acceptable and you need
	  to adjust pin multiplexing in SPL in order to boot into U-Boot,
	  enable this option. You will need to enable device tree in SPL
	  for this to work.
```

## drivers/video/Kconfig
```kconfig
config DISPLAY_PORT
	bool "Enable DisplayPort support"
	help
	   eDP (Embedded DisplayPort) is a standard widely used in laptops
	   to drive LCD panels. This framework provides support for enabling
	   these displays where supported by the video hardware.
```

## drivers/virtio/Kconfig
```kconfig
# SPDX-License-Identifier: GPL-2.0+
#
# Copyright (C) 2018, Tuomas Tynkkynen <tuomas.tynkkynen@iki.fi>
# Copyright (C) 2018, Bin Meng <bmeng.cn@gmail.com>

menu "VirtIO Drivers"

config VIRTIO
	bool
	help
	  This option is selected by any driver which implements the virtio
	  bus, such as CONFIG_VIRTIO_MMIO or CONFIG_VIRTIO_PCI.

config VIRTIO_MMIO
	bool "Platform bus driver for memory mapped virtio devices"
	select VIRTIO
	help
	  This driver provides support for memory mapped virtio
	  platform device driver.

config VIRTIO_NET
	bool "virtio net driver"
	depends on VIRTIO
	help
	  This is the virtual net driver for virtio. It can be used with
	  QEMU based targets.

config VIRTIO_BLK
	bool "virtio block driver"
	depends on VIRTIO
	help
	  This is the virtual block driver for virtio. It can be used with
	  QEMU based targets.

endmenu
```

## examples/Kconfig
```kconfig
# SPDX-License-Identifier: GPL-2.0+
#
# Copyright 2017 Emmanuel Vadot <manu@bidouilliste.com>

config EXAMPLES
	bool "Compile legacy API examples"
	depends on !SANDBOX
	default y if ARCH_QEMU_ARM
	help
	  U-Boot provides an legacy API for standalone applications. Examples
	  are provided in directory examples/.

config EXAMPLES_STANDALONE
	bool "Compile standalone examples"
	depends on EXAMPLES
	default y
	help
	  Build the various examples in the standalone/directory for use with
	  the legacy API.
```

## fs/Kconfig
```kconfig
#
# File system configuration
#

menu "File systems"

config FS_LEGACY
	def_bool y
	help
	  Enables legacy support for filesystems. This provides an interface
	  which can talk to one filesystem at a time, with the filesystem being
	  re-mounted on each operation.

source "fs/btrfs/Kconfig"

source "fs/cbfs/Kconfig"

source "fs/exfat/Kconfig"

source "fs/ext4/Kconfig"

source "fs/fat/Kconfig"

source "fs/jffs2/Kconfig"

source "fs/sandbox/Kconfig"

source "fs/ubifs/Kconfig"

source "fs/cramfs/Kconfig"

source "fs/yaffs2/Kconfig"

source "fs/squashfs/Kconfig"

source "fs/erofs/Kconfig"

endmenu
```

## legacy_api/Kconfig
```kconfig
config LEGACY_API
	bool "Enable Legacy U-Boot API"
	depends on CC_IS_GCC
	help
	  This option enables the legcay U-Boot API. See legacy_api/README for
	  more information.

	  Note that this is deprecated and not intended to be used. It will be
	  removed by the end of 2027.

menu "LEGACY API"
	depends on LEGACY_API

config SYS_MMC_MAX_DEVICE
	int  "Maximum number of MMC devices exposed via the legacy API"
	default 1

config STANDALONE_LOAD_ADDR
	depends on EXAMPLES
	hex "Address in memory to link standalone applications to"
	default 0xffffffff80200000 if MIPS && 64BIT
	default 0x8c000000 if SH
	default 0x82000000 if ARC
	default 0x80f00000 if MICROBLAZE
	default 0x80300000 if ARCH_OMAP2PLUS || FSL_LSCH2 || FSL_LSCH3
	default 0x80200000 if MIPS && 32BIT
	default 0x0c100000 if ARM
	default 0x02000000 if NIOS2
	default 0x00040000 if PPC || X86
	default 0x00020000 if M68K
	default 0x0 if RISCV
	default SYS_LOAD_ADDR
	help
	  This option defines a board specific value for the address where
	  standalone program gets loaded, thus overwriting the architecture
	  dependent default settings.

endmenu
```

## lib/efi/Kconfig
```kconfig
# SPDX-License-Identifier: GPL-2.0-or-later
#
# Copyright 2025 Simon Glass <sjg@chromium.org>
#

config EFI
	bool
	help
	  Indicates that EFI functionality is enabled, either via EFI_CLIENT or
	  EFI_LOADER

	  This is used to provide libraries shared by both.

if EFI_LOADER || EFI_APP

config EFI_BINARY_EXEC
	bool "Execute UEFI binary"
	default y
	help
	  Select this option if you want to execute the UEFI binary after
	  loading it with U-Boot load commands or other methods.
	  You may enable CMD_BOOTEFI_BINARY so that you can use bootefi
	  command to do that.

config EFI_DEVICE_PATH_TO_TEXT
	bool "Device path to text protocol"
	default y
	help
	  The device path to text protocol converts device nodes and paths to
	  human readable strings.

endif # EFI_LOADER || EFI_APP
```

## test/dm/Kconfig
```kconfig
config UT_DM
	bool "Enable driver model unit test command"
	depends on SANDBOX && UNIT_TEST
	help
	  This enables the 'ut dm' command which runs a series of unit
	  tests on the driver model code. Each subsystem (uclass) is tested.
	  If all is well then all tests pass although there will be a few
	  messages printed along the way.

config SPL_UT_DM
	def_bool b  # Enable driver model unit test command (SPL)
	depends on UT_DM && SPL
```

## ups.its
```
/dts-v1/;

/ {
	compatible = "universal-payload";
	description = "Tianocore 2022-08";
	upl-version = <0x0100>;	// top 8 bits major, bottom 8 minor
	images {
		tianocore {
			description = "Tianocore edk2-stable202208";
			type = "binary";
			arch = "x86_64";
			compression = "lzma";
			revision = <0x12345678>;
			build-type = "debug";
			capabilities = "smm-rebase", "...";
			producer = "My company";
			image-id = "tianocore";
			data = /incbin/("/scratch/sglass/edk2/Build/UefiPayloadPkgX64/DEBUG_CLANGDWARF/X64/UefiPayloadPkg/UefiPayloadEntry/UniversalPayloadEntry/DEBUG/UniversalPayloadEntry.dll");
			reloc-start = <0xc0000>;
			load = <0x120000>;
			hash-1 {
				algo = "sha256";
			};
		};

		uefi-fv {
			description = "UEFI Firmware Volume";
			type = "binary";
			arch = "x86_64";
			compression = "lzma";
			data = /incbin/("/scratch/sglass/edk2/Build/UefiPayloadPkgX64/DEBUG_CLANGDWARF/FV/DXEFV.Fv");
			hash-1 {
				algo = "sha256";
			};
		};
		bds-fv {
			description = "BDS Firmware Volume";
			type = "binary";
			arch = "x86_64";
			compression = "lzma";
			data = /incbin/("/scratch/sglass/edk2/Build/UefiPayloadPkgX64/DEBUG_CLANGDWARF/FV/BDSFV.Fv");
			hash-1 {
				algo = "sha256";
			};
		};
	};

	configurations {
		default = "conf-1";
		conf-1 {
			firmware = "tianocore";
			loadables = "uefi-fv", "bds-fv";
			signature {
				algo = "sha256,rsa2048";
				key-name-hint = "dev";   // key to sign with
				sign-images = "firmware", "loadables";
			};
		};
	};
};
```
